## config/boards/shields/left_device/Kconfig.shield
```kconfig
# Copyright (c) 2026 The ZMK Contributors
# SPDX-License-Identifier: MIT

config SHIELD_LEFT_DEVICE
    def_bool $(shields_list_contains,left_device)
```

## config/boards/shields/wrist_mouse/Kconfig.defconfig
```kconfig
# Copyright (c) 2026 The ZMK Contributors
# SPDX-License-Identifier: MIT

if SHIELD_WRIST_MOUSE

config ZMK_KEYBOARD_NAME
    default "Wrist Mouse"

endif
```

## config/boards/shields/wrist_mouse/Kconfig.shield
```kconfig
# Copyright (c) 2026 The ZMK Contributors
# SPDX-License-Identifier: MIT

config SHIELD_WRIST_MOUSE
    def_bool $(shields_list_contains,wrist_mouse)
```

## sub_feeder/firmware/shield/Kconfig.defconfig
```kconfig
# Copyright (c) 2026 The ZMK Contributors
# SPDX-License-Identifier: MIT

if SHIELD_LEFT_DEVICE

config ZMK_KEYBOARD_NAME
    default "Left Device"

endif
```
